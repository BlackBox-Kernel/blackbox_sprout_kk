## drivers/tty/serial/Kconfig.rej
```kconfig
--- drivers/tty/serial/Kconfig
+++ drivers/tty/serial/Kconfig
@@ -197,7 +197,7 @@
 config SERIAL_SAMSUNG_UARTS
 	int
 	depends on ARM && PLAT_SAMSUNG
-	default 6 if CPU_S5P6450
+	default 6 if ARCH_S5P6450
 	default 4 if SERIAL_SAMSUNG_UARTS_4 || CPU_S3C2416
 	default 3
 	help
```

## kernel/time/Kconfig
```kconfig
#
# Timer subsystem related configuration options
#

# Core internal switch. Selected by NO_HZ / HIGH_RES_TIMERS. This is
# only related to the tick functionality. Oneshot clockevent devices
# are supported independ of this.

config ANDROID	
  bool "Android Drivers"
	default N
	---help---
	  Enable support for various drivers needed on the Android platform

if ANDROID
config ANDROID_INTF_ALARM_DEV
	bool "Android alarm driver"
	depends on RTC_CLASS
	default n
	help
	  Provides non-wakeup and rtc backed wakeup alarms based on rtc or
	  elapsed realtime, and a non-wakeup alarm on the monotonic clock.
	  Also exports the alarm interface to user-space.

endif # if ANDROID

config TICK_ONESHOT
	bool

config NO_HZ_FULL_SYSIDLE
	bool "Detect full-system idle state for full dynticks system"
	depends on NO_HZ_FULL
	default n
	help
	 At least one CPU must keep the scheduling-clock tick running for
	 timekeeping purposes whenever there is a non-idle CPU, where
	 "non-idle" also includes dynticks CPUs as long as they are
	 running non-idle tasks.  Because the underlying adaptive-tick
	 support cannot distinguish between all CPUs being idle and
	 all CPUs each running a single task in dynticks mode, the
	 underlying support simply ensures that there is always a CPU
	 handling the scheduling-clock tick, whether or not all CPUs
	 are idle.  This Kconfig option enables scalable detection of
	 the all-CPUs-idle state, thus allowing the scheduling-clock
	 tick to be disabled when all CPUs are idle.  Note that scalable
	 detection of the all-CPUs-idle state means that larger systems
	 will be slower to declare the all-CPUs-idle state.

	 Say Y if you would like to help debug all-CPUs-idle detection.

	 Say N if you are unsure.

config NO_HZ
	bool "Tickless System (Dynamic Ticks)"
	depends on !ARCH_USES_GETTIMEOFFSET && GENERIC_CLOCKEVENTS
	select TICK_ONESHOT
	help
	  This option enables a tickless system: timer interrupts will
	  only trigger on an as-needed basis both when the system is
	  busy and when the system is idle.

config HIGH_RES_TIMERS
	bool "High Resolution Timer Support"
	depends on !ARCH_USES_GETTIMEOFFSET && GENERIC_CLOCKEVENTS
	select TICK_ONESHOT
	help
	  This option enables high resolution timer support. If your
	  hardware is not capable then this option only increases
	  the size of the kernel image.

config GENERIC_CLOCKEVENTS_BUILD
	bool
	default y
	depends on GENERIC_CLOCKEVENTS

config GENERIC_CLOCKEVENTS_MIN_ADJUST
	bool
```
